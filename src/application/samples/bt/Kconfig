## src/application/samples/bt/Kconfig
```kconfig
#===============================================================================
# @brief    Kconfig file.
# Copyright (c) HiSilicon (Shanghai) Technologies Co., Ltd. 2023-2023. All rights reserved.
#===============================================================================
choice
    prompt "Sample"

config SAMPLE_SUPPORT_BLE_SAMPLE
    bool "Support BLE Sample."

if SAMPLE_SUPPORT_BLE_SAMPLE
osource "application/samples/bt/ble/Kconfig"
endif

config SAMPLE_SUPPORT_SLE_SAMPLE
    bool "Support SLE Sample."

if SAMPLE_SUPPORT_SLE_SAMPLE
osource "application/samples/bt/sle/Kconfig"
endif

config SAMPLE_SUPPORT_CHBA_SAMPLE
    bool "Support CHBA Sample."

config SAMPLE_SUPPORT_MESH
    bool
    prompt "Support Mesh."
    default y
    help
        This option means support ble mesh sample.
if SAMPLE_SUPPORT_MESH
    config SAMPLE_SUPPORT_BLE_MESH
        bool
        prompt "Support Ble Mesh sample."
        default n
        help
            This option means support ble mesh sample.
    if SAMPLE_SUPPORT_BLE_MESH
    menu "Support Ble Mesh Sample Configuration"
        osource "application/samples/bt/ble/mesh/Kconfig"
    endmenu
    endif

    config SAMPLE_SUPPORT_SLE_MESH
        bool
        prompt "Support Sle Mesh sample."
        default y
        help
            This option means support sle mesh sample.
    if SAMPLE_SUPPORT_SLE_MESH
    menu "Support Sle Mesh Sample Configuration"
        osource "application/samples/bt/sle/mesh/Kconfig"
    endmenu
    endif

endif

endchoice
```

## src/application/samples/bt/ble/Kconfig
```kconfig
#===============================================================================
# @brief    Kconfig file.
# Copyright (c) HiSilicon (Shanghai) Technologies Co., Ltd. 2023-2023. All rights reserved.
#===============================================================================

choice
    prompt "BLE Sample"

config SAMPLE_SUPPORT_BLE_SPEED_SERVER_SAMPLE
    bool "Support BLE Throughput Server Sample."

if SAMPLE_SUPPORT_BLE_SPEED_SERVER_SAMPLE
osource "application/samples/bt/ble/ble_speed_server/Kconfig"
endif

config SAMPLE_SUPPORT_BLE_SPEED_CLIENT_SAMPLE
    bool "Support BLE Throughput Client Sample"

config SAMPLE_SUPPORT_BLE_CFG_SAMPLE
    bool "Support BLE WIFI CFG Sample"

config SAMPLE_SUPPORT_BLE_UART_BRIDGE_SERVER_SAMPLE
    bool "Support BLE UART Bridge Server Sample"

config SAMPLE_SUPPORT_BLE_UART_BRIDGE_CLIENT_SAMPLE
    bool "Support BLE UART Bridge Client Sample"

config SAMPLE_SUPPORT_BLE_SENSOR_REPORT_SERVER_SAMPLE
    bool "Support BLE Sensor Report Server Sample"

config SAMPLE_SUPPORT_BLE_SENSOR_REPORT_CLIENT_SAMPLE
    bool "Support BLE Sensor Report Client Sample"

config SAMPLE_SUPPORT_BLE_GATEWAY_SERVER_SAMPLE
    bool "Support BLE Gateway Sensor Node Sample"

config SAMPLE_SUPPORT_BLE_GATEWAY_CLIENT_SAMPLE
    bool "Support BLE Gateway Central Sample"
endchoice
```

## src/application/samples/bt/ble/ble_gateway/Kconfig
```kconfig
menu "BLE MQTT Gateway Configuration"

config GATEWAY_WIFI_SSID
    string "Gateway Wi-Fi SSID"
    default ""
    help
        Private deployment value. Configure locally and never commit the configured target file.

config GATEWAY_WIFI_PASSWORD
    string "Gateway Wi-Fi password"
    default ""
    help
        Secret deployment value. Configure locally and never commit it or include it in documentation.

config IOTDA_MQTT_HOST
    string "IoTDA MQTTS host"
    default ""
    help
        Configure the MQTTS access host shown by the selected IoTDA instance.

config IOTDA_MQTT_PORT
    int "IoTDA MQTTS port"
    range 1 65535
    default 8883

config IOTDA_DEVICE_ID
    string "IoTDA device ID"
    default ""
    help
        This value is sensitive deployment data. Keep it in a private local configuration.

config IOTDA_DEVICE_SECRET
    string "IoTDA device secret"
    default ""
    help
        This value is secret. Never commit a configured target .config or firmware package.

config IOTDA_AUTH_TIMESTAMP
    string "IoTDA no-timestamp-check authentication timestamp"
    default "2020010100"
    help
        Ten UTC digits used with signature type 0. IoTDA does not validate its freshness.

config IOTDA_SERVICE_ID
    string "IoTDA product model service ID"
    default "environment"

endmenu
```

## src/application/samples/bt/ble/ble_uart_bridge/Kconfig
```kconfig
#===============================================================================
# @brief    Kconfig file for the BLE Hello sample.
# Copyright (c) HiSilicon (Shanghai) Technologies Co., Ltd. 2023-2026.
# All rights reserved.
#===============================================================================

config SAMPLE_SUPPORT_BLE_UART_BRIDGE_SERVER_SAMPLE
    bool "Support BLE Hello Server Sample"

config SAMPLE_SUPPORT_BLE_UART_BRIDGE_CLIENT_SAMPLE
    bool "Support BLE Hello Client Sample"
```

## src/application/samples/bt/ble/mesh/Kconfig
```kconfig
#===============================================================================
# @brief    Kconfig file.
# Copyright (c) HiSilicon (Shanghai) Technologies Co., Ltd. 2023-2023. All rights reserved.
#===============================================================================
choice
    prompt "BLE mesh Sample"

config SAMPLE_SUPPORT_BLE_MESH_DEVICE
    bool "Support Ble Mesh device sample."

config SAMPLE_SUPPORT_BLE_MESH_PROV
    bool "Support Ble Mesh prov sample."
endchoice

config BLE_MESH_TARGET
    bool
    default y if SAMPLE_SUPPORT_BLE_MESH_PROV || SAMPLE_SUPPORT_BLE_MESH_DEVICE

config BLE_MESH_DEVICE
    bool
    default y if SAMPLE_SUPPORT_BLE_MESH_DEVICE

config BLE_MESH_PROVISIONER_ADV
    bool
    default y if SAMPLE_SUPPORT_BLE_MESH_PROV
```

## src/application/samples/bt/sle/Kconfig
```kconfig
#===============================================================================
# @brief    Kconfig file.
# Copyright (c) HiSilicon (Shanghai) Technologies Co., Ltd. 2023-2023. All rights reserved.
#===============================================================================

choice
    prompt "SLE Sample"

config SAMPLE_SUPPORT_SLE_SPEED_SERVER_SAMPLE
    bool "Support SLE Throughput Server Sample."

config LARGE_THROUGHPUT_SERVER
    bool "server large throughput."
    default y
    depends on SAMPLE_SUPPORT_SLE_SPEED_SERVER_SAMPLE

config SAMPLE_SUPPORT_SLE_SPEED_CLIENT_SAMPLE
    bool "Support SLE Throughput Client Sample."

config LARGE_THROUGHPUT_CLIENT
    bool "client large throughput."
    default y
    depends on SAMPLE_SUPPORT_SLE_SPEED_CLIENT_SAMPLE

config SAMPLE_SUPPORT_SLE_DEVICE_CONFIG_SERVER_SAMPLE
    bool "Support SLE Device Config Server Sample."

if SAMPLE_SUPPORT_SLE_DEVICE_CONFIG_SERVER_SAMPLE
osource "application/samples/bt/sle/sle_device_config/Kconfig"
endif

config SAMPLE_SUPPORT_SLE_DEVICE_CONFIG_CLIENT_SAMPLE
    bool "Support SLE Device Config Client Sample."

if SAMPLE_SUPPORT_SLE_DEVICE_CONFIG_CLIENT_SAMPLE
osource "application/samples/bt/sle/sle_device_config/Kconfig"
endif

config SAMPLE_SUPPORT_SLE_FRAGMENTATION_SERVER_SAMPLE
    bool "Support SLE Fragmentation Server Sample."

if SAMPLE_SUPPORT_SLE_FRAGMENTATION_SERVER_SAMPLE
osource "application/samples/bt/sle/sle_fragmentation/Kconfig"
endif

config SAMPLE_SUPPORT_SLE_FRAGMENTATION_CLIENT_SAMPLE
    bool "Support SLE Fragmentation Client Sample."

if SAMPLE_SUPPORT_SLE_FRAGMENTATION_CLIENT_SAMPLE
osource "application/samples/bt/sle/sle_fragmentation/Kconfig"
endif

endchoice
```

## src/application/samples/bt/sle/mesh/Kconfig
```kconfig
#===============================================================================
# @brief    Kconfig file.
# Copyright (c) HiSilicon (Shanghai) Technologies Co., Ltd. 2026-2026. All rights reserved.
#===============================================================================
config SAMPLE_SUPPORT_SLE_MESH_ONE_TOUCH_START
    bool
    prompt "Support Sle Mesh one touch start sample."
    default n
    help
        This option means support sle mesh one touch start sample.

config SAMPLE_SUPPORT_SLE_MESH_SAMPLE
    bool
    default y if SAMPLE_SUPPORT_SLE_MESH_ONE_TOUCH_START

if SAMPLE_SUPPORT_SLE_MESH_ONE_TOUCH_START
    menu "Support Sle Mesh one touch start Sample Configuration"
        osource "application/samples/bt/sle/mesh/Kconfig_one_touch_start"
    endmenu
endif
```

## src/application/samples/bt/sle/sle_fragmentation/Kconfig
```kconfig
#===============================================================================
# @brief    Kconfig file for SLE Fragmentation sample.
# Copyright (c) @CompanyNameMagicTag 2023-2023. All rights reserved.
#===============================================================================

config SUPPORT_SLE_PERIPHERAL
    bool
    default y if SAMPLE_SUPPORT_SLE_FRAGMENTATION_SERVER_SAMPLE

config SUPPORT_SLE_CENTRAL
    bool
    default y if SAMPLE_SUPPORT_SLE_FRAGMENTATION_CLIENT_SAMPLE
```

## src/application/samples/os/Kconfig
```kconfig
#===============================================================================
# @brief    Kconfig file for OSAL and RTOS samples.
# Copyright (c) HiSilicon (Shanghai) Technologies Co., Ltd. 2026. All rights reserved.
#===============================================================================

choice
    prompt "Select an OSAL IPC sample."
    depends on ENABLE_OS_SAMPLE

config SAMPLE_SUPPORT_OSAL_EVENT_FLAG
    bool
    prompt "Support OSAL event flag Sample."
    help
        This option enables the OSAL event flag AND-wait sample.

config SAMPLE_SUPPORT_OSAL_MUTEX
    bool
    prompt "Support OSAL mutex Sample."
    help
        This option enables the OSAL mutex exclusive-access sample.

config SAMPLE_SUPPORT_OSAL_MSG_QUEUE
    bool
    prompt "Support OSAL interrupt-to-task message queue Sample."
    help
        This option enables the interrupt-to-task message queue sample.

config SAMPLE_SUPPORT_OSAL_SEMAPHORE
    bool
    prompt "Support OSAL semaphore Sample."
    help
        This option enables the OSAL producer-consumer semaphore sample.

endchoice

config SAMPLE_SUPPORT_OSAL_KMALLOC
    bool
    prompt "Support OSAL dynamic memory Sample."
    default n
    depends on ENABLE_OS_SAMPLE
    help
        This option enables the OSAL dynamic memory allocation sample.

config SAMPLE_SUPPORT_OSAL_TASK_CONCURRENCY
    bool
    prompt "Support OSAL task concurrency Sample."
    default n
    depends on ENABLE_OS_SAMPLE
    help
        This option enables the OSAL task concurrency and priority preemption sample.

config SAMPLE_SUPPORT_OSAL_INTERRUPT
    bool
    prompt "Support OSAL interrupt management Sample."
    default n
    depends on ENABLE_OS_SAMPLE
    help
        This option enables the OSAL interrupt registration and handling sample.
```

## src/application/samples/peripheral/pmp/Kconfig
```kconfig
#===============================================================================
# @brief    Kconfig file.
# Copyright (c) HiSilicon (Shanghai) Technologies Co., Ltd. 2026. All rights reserved.
#===============================================================================
config PMP_SAMPLE_TRIGGER_FAULT
    bool
    prompt "Trigger a protected write for exception verification."
    default n
    help
        Write to the sample's read-only PMP region. This
        intentionally raises a store access fault and reboots or stops the CPU.
```

## src/application/samples/peripheral/rtc/Kconfig
```kconfig
#===============================================================================
# @brief    Kconfig file.
# Copyright (c) HiSilicon (Shanghai) Technologies Co., Ltd. 2026. All rights reserved.
#===============================================================================
config RTC_SAMPLE_PERIOD_MS
    int
    prompt "RTC sampling period in milliseconds."
    range 100 60000
    default 1000
```

## src/kernel/liteos/liteos_v208.5.0/Huawei_LiteOS/compat/Kconfig
```kconfig
menu "Compat"
osource "compat/cmsis/Kconfig"
osource "compat/linux/Kconfig"

config LOSCFG_COMPAT_RT_THREAD
    bool "Enable RT-Thread compatibility component"
    default n
    help
      Enable the independently distributed RT-Thread 5.2.1 compatibility
      component. The LiteOS adaptation and tailored RT-Thread sources are
      supplied by the FBB project dependency instead of the kernel tree.

config LOSCFG_COMPAT_FREERTOS
    bool "Enable FreeRTOS"
    default n
    help
      Answer Y to enable LiteOS support FreeRTOS interface.

endmenu
```
